## config/west.yml
```yaml
manifest:
  remotes:
    - name: zmkfirmware
      url-base: https://github.com/zmkfirmware
    - name: kilipan
      url-base: https://github.com/kilipan
  projects:
    - name: zmk
      remote: zmkfirmware
      revision: v0.3.0
      import: app/west.yml
    - name: zmk-keyboards-zilpzalp
      remote: kilipan
      revision: main
  self:
    path: config
```
